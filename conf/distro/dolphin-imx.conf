## conf/distro/dolphin-imx.conf
```bitbake
# imx6ull DISTRO

include conf/distro/include/dolphin-imx-base.inc
include conf/distro/include/dolphin-imx-preferred-env.inc

DISTRO = "dolphin-imx"
DISTRO_NAME = "imx6ull Release Distro"
DISTRO_VERSION = "5.4-dolphin"

# Remove conflicting backends.
DISTRO_FEATURES_remove = "x11 wayland directfb "
```

## conf/distro/include/dolphin-imx-base.inc
```bitbake
require conf/distro/poky.conf

DISTRO = "imx-nxp"
DISTRO_NAME = "NXP i.MX Release Distro"
DISTRO_VERSION = "5.4-zeus"

MAINTAINER = "NXP <lauren.post@nxp.com>"

REMOVE_VULKAN_FEATURE = "vulkan"
POKY_DEFAULT_DISTRO_FEATURES_remove      = "wayland ${REMOVE_VULKAN_FEATURE}"

INHERIT_remove = "uninative"
```

## conf/layer.conf
```bitbake
# We have a conf and classes directory, add to BBPATH
BBPATH .= ":${LAYERDIR}"

# We have a packages directory, add to BBFILES
BBFILES += "${LAYERDIR}/recipes-*/*/*.bb \
            ${LAYERDIR}/recipes-*/*/*.bbappend"

BBFILE_COLLECTIONS += "dolphin-imx6ull"
BBFILE_PATTERN_dolphin-imx6ull := "^${LAYERDIR}/"
BBFILE_PRIORITY_dolphin-imx6ull = "9"
LAYERSERIES_COMPAT_dolphin-imx6ull = "warrior zeus"

HOSTTOOLS_NONFATAL_append = " bc rsync xxd"

# optee is no longer a valid distro feature. Use machine feature to remove, like this:
MACHINE_FEATURES_remove = "optee"
MACHINE_FEATURES_remove = "optee-client"
MACHINE_FEATURES_remove = "optee-os"
MACHINE_FEATURES_remove = "optee-test"
# DEPRECATED: The ability to remove optee from the build is deprecated and
# will be removed in some future release.

DISTRO_FEATURES_FILTER_NATIVESDK += "wayland"

MACHINE_USES_VIVANTE_KERNEL_DRIVER_MODULE ?= "0"

MACHINE_SOCARCH_FILTER_append_imxgpu = " opencv"

MACHINE_SOCARCH_FILTER_remove = " imx-parser alsa-lib gstreamer1.0"

# Use latest SDMA firmware from firmware-imx instead of upstream linux-firmware
MACHINE_FIRMWARE_remove_mx6  = "linux-firmware-imx-sdma-imx6q"
MACHINE_FIRMWARE_append_mx6  = " firmware-imx-sdma firmware-imx-regulatory"

MACHINE_FIRMWARE_append = " ${@bb.utils.contains('MACHINE_FEATURES', 'bcm4339', 'linux-firmware-bcm4339', '', d)}"
MACHINE_FIRMWARE_append = " ${@bb.utils.contains('MACHINE_FEATURES', 'bcm43430', 'linux-firmware-bcm43430', '', d)}"
MACHINE_FIRMWARE_append = " ${@bb.utils.contains('MACHINE_FEATURES', 'bcm43455', 'linux-firmware-bcm43455', '', d)}"
MACHINE_FIRMWARE_append = " ${@bb.utils.contains('MACHINE_FEATURES', 'bcm4356', 'linux-firmware-bcm4356-pcie', '', d)}"
MACHINE_FIRMWARE_append = " ${@bb.utils.contains('MACHINE_FEATURES', 'bcm4359', 'linux-firmware-bcm4359-pcie', '', d)}"
MACHINE_FIRMWARE_append = " ${@bb.utils.contains('MACHINE_FEATURES', 'nxp8987', 'linux-firmware-nxp8987', '', d)}"

# Extra Marvell Wi-Fi & BTE driver and firmware
MACHINE_EXTRA_RRECOMMENDS_append = " ${@bb.utils.contains('MACHINE_FEATURES', 'mrvl8997', 'packagegroup-imx-mrvl8997', '', d)}"

# Extra NXP Wlan SDK
MACHINE_EXTRA_RRECOMMENDS_append = " ${@bb.utils.contains('MACHINE_FEATURES', 'nxp8987', 'nxp-wlan-sdk', '', d)}"

MACHINE_GSTREAMER_1_0_PLUGIN_mx6ul ?= "imx-gst1.0-plugin"

PREFERRED_VERSION_weston_mx6 ?= "8.0.0.imx"

PREFERRED_VERSION_wayland-protocols_mx6 = "1.18.imx"

PREFERRED_VERSION_libdrm_mx6 ?= "2.4.99.imx"

PREFERRED_VERSION_isp-imx ?= "4.2.2.2"
PREFERRED_VERSION_basler-camera ?= "4.2.2.2"

SOC_DEFAULT_IMAGE_FSTYPES_remove = "wic.gz"
SOC_DEFAULT_IMAGE_FSTYPES_append = " wic.bz2 tar.bz2"

# Remove from upstream
SDCARD_ROOTFS = "NO_LONGER_USED"

IMAGE_BOOT_FILES_append = " \
    ${@bb.utils.contains('COMBINED_FEATURES', 'xen', 'xen', '', d)} \
"

IMAGE_INSTALL_append = " \
    ${@bb.utils.contains('COMBINED_FEATURES', 'jailhouse', 'jailhouse', '', d)} \
    ${@bb.utils.contains('COMBINED_FEATURES', 'xen', 'imx-xen-base imx-xen-hypervisor', '', d)} \
"

MACHINE_FEATURES_append_imx    = " nxp8987"
```

## conf/machine/imx6ull-dolphin-dk.conf
```bitbake
#@TYPE: Machine
#@NAME: NXP i.MX6ULL Dolphin Develop Kit
#@SOC: i.MX6ULL
#@DESCRIPTION: Machine configuration for NXP i.MX6ULL Dolphin DK
#@MAINTAINER: Weiye Wang <wytxjy@163.com>

MACHINEOVERRIDES =. "mx6:mx6ul:mx6ull:"

include conf/machine/include/imx-dolphin-base.inc
include conf/machine/include/tune-cortexa7.inc

KERNEL_DEVICETREE = "imx6ull-14x14-evk.dtb imx6ull-14x14-evk-btwifi.dtb \
                     imx6ull-14x14-evk-btwifi-oob.dtb imx6ull-14x14-evk-emmc.dtb \
                     imx6ull-14x14-evk-gpmi-weim.dtb"

UBOOT_CONFIG ??= "sd emmc nand"
UBOOT_CONFIG[sd] = "mx6ull_14x14_evk_config,sdcard"
UBOOT_CONFIG[emmc] = "mx6ull_14x14_evk_emmc_config,sdcard"
UBOOT_CONFIG[nand] = "mx6ull_14x14_evk_nand_config,ubifs"
UBOOT_CONFIG[qspi1] = "mx6ull_14x14_evk_qspi1_config"
UBOOT_CONFIG[mfgtool] = "mx6ull_14x14_evk_config"

MACHINE_FEATURES += "wifi bluetooth bcm4339 bcm43455"
```
